## conf/layer.conf
```bitbake
# We have a conf and classes directory, add to BBPATH
BBPATH .= ":${LAYERDIR}"

# We have recipes-* directories, add to BBFILES
BBFILES += "${LAYERDIR}/recipes-*/*/*.bb \
            ${LAYERDIR}/recipes-*/*/*.bbappend"

BBFILE_COLLECTIONS += "../meta-lorawan-rak831"
BBFILE_PATTERN_../meta-lorawan-rak831 = "^${LAYERDIR}/"
BBFILE_PRIORITY_../meta-lorawan-rak831 = "6"

DISTRO_FEATURES_append = " systemd wifi zeroconf"
VIRTUAL-RUNTIME_init_manager = "systemd"
DISTRO_FEATURES_BACKFILL_CONSIDERED = "sysvinit"
VIRTUAL-RUNTIME_initscripts = ""

# We do not want a serial console on the rpi3 since that uart is connected to the gps.  
SERIAL_CONSOLE=""
SERIAL_CONSOLES=""

# RPi config
# SPI is needed for the lora concentrator
ENABLE_SPI_BUS = "1"
# ENABLE_UART is needed to enable miniuart onto which, by default, the gps serial pins are connected to
ENABLE_UART = "1"
# I2C is just a nicety in case we want sensor/misc attachments
ENABLE_I2C ?= "1"
```
